## meta-oszl/conf/distro/osz-link.conf
```bitbake
require conf/distro/openbmc-phosphor.conf

DISTRO_NAME = "oß.link"
DISTRO_VERSION = "0.1"
```

## meta-oszl/conf/layer.conf
```bitbake
# We have a conf and classes directory, add to BBPATH
BBPATH .= ":${LAYERDIR}"

# We have recipes-* directories, add to BBFILES
BBFILES += "${LAYERDIR}/recipes-*/*/*.bb \
            ${LAYERDIR}/recipes-*/*/*.bbappend"

BBFILE_COLLECTIONS += "oszl-layer"
BBFILE_PATTERN_oszl-layer := "^${LAYERDIR}/"
BBFILE_PRIORITY_oszl-layer = "7"
LAYERSERIES_COMPAT_oszl-layer := "nanbield scarthgap"
```
